## drivers/media/platform/starfive/Kconfig
```kconfig
#
# VIN sensor driver configuration
#
config VIN_SENSOR_OV5640
	bool "VIN SENSOR support OV5640"
	depends on VIDEO_STF_VIN
	default n
	help
	  Say Y here if you want to have support for VIN sensor OV5640

config VIDEO_STARFIVE_VIN_SENSOR_IMX219
	bool "Sony IMX219 CMOS Image Sensor && FB_STARFIVE_VIDEO"
	help
	  Say Y here if you want to have support for VIN sensor IMX219
config FB_STARFIVE_VIDEO
	bool "fb_starfive_video support for camera"
	help
	  Say Y here if you want to have support for VIN sensor IMX219
config VIN_SENSOR_SC2235
	bool "VIN SENSOR support SC2235"
	depends on VIDEO_STF_VIN
	default n
	help
	  Say Y here if you want to have support for VIN sensor SC2235
```

## drivers/video/fbdev/starfive/Kconfig
```kconfig
#
# Video TX driver configuration
#
menu "Video TX Configuration"

config FB_STARFIVE_HDMI_ADV7513
	bool "HDMI ADV7513 displayer support"
	depends on FB_STARFIVE
	help
	  Say Y here if you want to have support for ADV7513 displayer
config FB_STARFIVE_HDMI_TDA998X
	bool "HDMI TDA998X displayer support"
	help
	  Say Y here if you want to have support for TDA998X displayer

endmenu
```
